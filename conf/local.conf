## conf/local.conf
```bitbake
# BeagleBone Black build configuration

MACHINE = "beaglebone-yocto"
DISTRO ?= "poky"

# Build performance
BB_NUMBER_THREADS ?= "${@oe.utils.cpu_count()}"
PARALLEL_MAKE ?= "-j ${@oe.utils.cpu_count()}"

# Package format
PACKAGE_CLASSES = "package_ipk"

# Image features
EXTRA_IMAGE_FEATURES = "debug-tweaks"
IMAGE_FSTYPES = "wic"

# Additional packages
IMAGE_INSTALL:append = " network-config"

# systemd
DISTRO_FEATURES:append = " systemd usrmerge"
VIRTUAL-RUNTIME_init_manager = "systemd"

CONF_VERSION = "2"

# Disk space monitoring
BB_DISKMON_DIRS ??= "\
    STOPTASKS,${TMPDIR},1G,100K \
    STOPTASKS,${DL_DIR},1G,100K \
    STOPTASKS,${SSTATE_DIR},1G,100K \
    STOPTASKS,/tmp,100M,100K \
    HALT,${TMPDIR},100M,1K \
    HALT,${DL_DIR},100M,1K \
    HALT,${SSTATE_DIR},100M,1K \
    HALT,/tmp,10M,1K"
```

## meta-redtooth/conf/layer.conf
```bitbake
BBPATH .= ":${LAYERDIR}"
BBFILES += "${LAYERDIR}/recipes-*/*/*.bb \
            ${LAYERDIR}/recipes-*/*/*.bbappend"

BBFILE_COLLECTIONS += "meta-redtooth"
BBFILE_PATTERN_meta-redtooth = "^${LAYERDIR}/"
BBFILE_PRIORITY_meta-redtooth = "6"

LAYERDEPENDS_meta-redtooth = "core"
LAYERSERIES_COMPAT_meta-redtooth = "scarthgap"
```
